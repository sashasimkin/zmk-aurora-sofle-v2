## boards/shields/splitkb_aurora_sofle/Kconfig.shield
```kconfig
# Copyright (c) 2023 The ZMK Contributors
# SPDX-License-Identifier: MIT

config SHIELD_SPLITKB_AURORA_SOFLE_DONGLE
    def_bool $(shields_list_contains,splitkb_aurora_sofle_dongle)

config SHIELD_SPLITKB_AURORA_SOFLE_PERIPHERAL_LEFT
    def_bool $(shields_list_contains,splitkb_aurora_sofle_peripheral_left)
```

## boards/shields/splitkb_aurora_sofle_dongled/Kconfig.defconfig
```kconfig
# Copyright (c) 2023 The ZMK Contributors
# SPDX-License-Identifier: MIT

if SHIELD_SPLITKB_AURORA_SOFLE_DONGLED_CENTRAL_LEFT || SHIELD_SPLITKB_AURORA_SOFLE_DONGLED_DONGLE

config ZMK_KEYBOARD_NAME
    default "Aurora Sofle"

config ZMK_SPLIT_ROLE_CENTRAL
    default y

endif

if SHIELD_SPLITKB_AURORA_SOFLE_DONGLED_DONGLE

# Set this to the number of peripherals your dongle will have.
# For a unibody, this would be 1. If you have left and right halves, set it to 2, etc.
config ZMK_SPLIT_BLE_CENTRAL_PERIPHERALS
    default 2

endif

if SHIELD_SPLITKB_AURORA_SOFLE_DONGLED_CENTRAL_LEFT || SHIELD_SPLITKB_AURORA_SOFLE_DONGLED_DONGLE || SHIELD_SPLITKB_AURORA_SOFLE_DONGLED_LEFT || SHIELD_SPLITKB_AURORA_SOFLE_DONGLED_RIGHT

config ZMK_SPLIT
    default y

config ZMK_RGB_UNDERGLOW
    select WS2812_STRIP
    select SPI

if ZMK_DISPLAY

config SSD1306
    default y

config I2C
    default y

endif # ZMK_DISPLAY

if LVGL

config LV_Z_VDB_SIZE
    default 64

config LV_DPI_DEF
    default 148

config LV_Z_BITS_PER_PIXEL
    default 1

choice LV_COLOR_DEPTH
    default LV_COLOR_DEPTH_1
endchoice

endif # LVGL

endif # SHIELD_SPLITKB_AURORA_SOFLE_DONGLED_CENTRAL_LEFT || SHIELD_SPLITKB_AURORA_SOFLE_DONGLED_DONGLE || SHIELD_SPLITKB_AURORA_SOFLE_DONGLED_LEFT || SHIELD_SPLITKB_AURORA_SOFLE_DONGLED_RIGHT
```

## boards/shields/splitkb_aurora_sofle_dongled/Kconfig.shield
```kconfig
# Copyright (c) 2023 The ZMK Contributors
# SPDX-License-Identifier: MIT

config SHIELD_SPLITKB_AURORA_SOFLE_DONGLED_DONGLE
    def_bool $(shields_list_contains,splitkb_aurora_sofle_dongled_dongle)

config SHIELD_SPLITKB_AURORA_SOFLE_DONGLED_CENTRAL_LEFT
    def_bool $(shields_list_contains,splitkb_aurora_sofle_dongled_central_left)

config SHIELD_SPLITKB_AURORA_SOFLE_DONGLED_LEFT
    def_bool $(shields_list_contains,splitkb_aurora_sofle_dongled_left)

config SHIELD_SPLITKB_AURORA_SOFLE_DONGLED_RIGHT
    def_bool $(shields_list_contains,splitkb_aurora_sofle_dongled_right)
```
