#include <dt-bindings/zmk/matrix_transform.h>

#include "splitkb_aurora_sofle_dongled.dtsi"

/ {
    chosen {
        zmk,kscan = &mock_kscan;
    };

    mock_kscan: mock_kscan_0 {
        compatible = "zmk,kscan-mock";
        wakeup-source;
        columns = <0>;
        rows = <0>;
        events = <0>;
    };
};
